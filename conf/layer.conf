## conf/layer.conf
```bitbake
# We have a conf and classes directory, add to BBPATH
BBPATH .= ":${LAYERDIR}"

# We have recipes-* directories, add to BBFILES
BBFILES += "${LAYERDIR}/recipes-*/*/*.bb \
            ${LAYERDIR}/recipes-*/*/*.bbappend"

BBFILE_COLLECTIONS += "meta-pcduino"
BBFILE_PATTERN_meta-pcduino = "^${LAYERDIR}/"
BBFILE_PRIORITY_meta-pcduino = "6"

LAYERDEPENDS_meta-pcduino = "core"
LAYERSERIES_COMPAT_meta-pcduino = "dunfell"
```

## conf/machine/pcduino_dev.conf
```bitbake
#@TYPE: Machine
#@NAME: pcduino-dev
#@DESCRIPTION: Machine configuration for the pcDuino v1 base on allwinner a10 CPU

require conf/machine/include/sun4i.inc

#PREFERRED_VERSION_u-boot = "v2018.09%"

PREFERRED_PROVIDER_virtual/kernel = "linux-new"

KERNEL_DEVICETREE = "sun4i-a10-pcduino.dtb"
UBOOT_MACHINE = "Linksprite_pcDuino_dev_defconfig"
SUNXI_FEX_FILE = "sys_config/a10/pcduino.fex"
```
